#include <behaviors.dtsi>
#include <dt-bindings/zmk/keys.h>
#include <dt-bindings/zmk/bt.h>
#include <dt-bindings/zmk/rgb.h>
#include <dt-bindings/zmk/stp.h>
#include <dt-bindings/zmk/backlight.h>
#include <dt-bindings/zmk/pointing.h>


#define QWERTY  0
#define DVORAK  1
#define DVORAKP 2
#define FN      3
#define MOD     4
#define LEAGUE  5

/ {
    behaviors {
      #include "macros.dtsi"
      #include "version.dtsi"
    };

  keymap {
    compatible = "zmk,keymap";
    #include "keymaps.dtsi"
  };
};
